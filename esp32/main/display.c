#include "display.h"

#include <string.h>

#include "board_pins.h"

#if BOARD_HAS_VOICE_HW

#include "driver/i2c_master.h"
#include "esp_check.h"
#include "esp_log.h"
#include "freertos/FreeRTOS.h"
#include "freertos/semphr.h"

#define OLED_ADDR   0x3C
#define OLED_I2C_HZ 400000
#define OLED_W      128
#define OLED_H      32

static const char *TAG = "display";

static i2c_master_dev_handle_t s_dev;
static SemaphoreHandle_t s_lock;
static uint8_t s_fb[OLED_W * OLED_H / 8];
static bool s_ready;

// 5x7 ASCII font, 0x20..0x7E, LSB = top row.
static const uint8_t FONT[][5] = {
    {0x00,0x00,0x00,0x00,0x00},{0x00,0x00,0x5F,0x00,0x00},{0x00,0x07,0x00,0x07,0x00},{0x14,0x7F,0x14,0x7F,0x14},
    {0x24,0x2A,0x7F,0x2A,0x12},{0x23,0x13,0x08,0x64,0x62},{0x36,0x49,0x55,0x22,0x50},{0x00,0x05,0x03,0x00,0x00},
    {0x00,0x1C,0x22,0x41,0x00},{0x00,0x41,0x22,0x1C,0x00},{0x08,0x2A,0x1C,0x2A,0x08},{0x08,0x08,0x3E,0x08,0x08},
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    {0x00,0x00,0x7F,0x00,0x00},{0x00,0x41,0x36,0x08,0x00},{0x08,0x08,0x2A,0x1C,0x08},
};

static esp_err_t send(uint8_t control, const uint8_t *data, size_t n)
{
    static uint8_t buf[1 + sizeof(s_fb)];
    buf[0] = control; // 0x00 = command stream, 0x40 = data stream
    memcpy(buf + 1, data, n);
    return i2c_master_transmit(s_dev, buf, n + 1, 200);
}

static void flush(void)
{
    static const uint8_t window[] = {0x21, 0, OLED_W - 1, 0x22, 0, OLED_H / 8 - 1};
    if (send(0x00, window, sizeof(window)) == ESP_OK) {
        send(0x40, s_fb, sizeof(s_fb));
    }
}

// Renders one UTF-8 line. Turkish letters map to their ASCII base so the 5x7 font can draw them.
static void draw_line(int row, const char *s)
{
    uint8_t *dst = &s_fb[row * OLED_W];
    int x = 0;
    while (*s && x + 5 <= OLED_W) {
        unsigned char c = (unsigned char)*s;
        int len = 1;
        char out = (char)c;
        if (c >= 0x80) {
            unsigned char d = (unsigned char)s[1];
            len = (c & 0xE0) == 0xC0 ? 2 : (c & 0xF0) == 0xE0 ? 3 : (c & 0xF8) == 0xF0 ? 4 : 1;
            out = '?';
            if (c == 0xC3) {
                out = d == 0xA7 ? 'c' : d == 0x87 ? 'C' : d == 0xB6 ? 'o' : d == 0x96 ? 'O'
                    : d == 0xBC ? 'u' : d == 0x9C ? 'U' : '?';
            } else if (c == 0xC4) {
                out = d == 0x9F ? 'g' : d == 0x9E ? 'G' : d == 0xB1 ? 'i' : d == 0xB0 ? 'I' : '?';
            } else if (c == 0xC5) {
                out = d == 0x9F ? 's' : d == 0x9E ? 'S' : '?';
            }
        }
        if (out < 0x20 || out > 0x7E) {
            out = '?';
        }
        memcpy(dst + x, FONT[out - 0x20], 5);
        x += 6;
        for (int i = 0; i < len && *s; i++) {
            s++;
        }
    }
}

esp_err_t display_init(void)
{
    i2c_master_bus_config_t bus_cfg = {
        .i2c_port = I2C_NUM_0,
        .scl_io_num = PIN_OLED_SCL,
        .sda_io_num = PIN_OLED_SDA,
        .clk_source = I2C_CLK_SRC_DEFAULT,
        .glitch_ignore_cnt = 7,
        .flags.enable_internal_pullup = true,
    };
    i2c_master_bus_handle_t bus;
    esp_err_t err = i2c_new_master_bus(&bus_cfg, &bus);
    if (err == ESP_OK) {
        err = i2c_master_probe(bus, OLED_ADDR, 50);
    }
    if (err != ESP_OK) {
        ESP_LOGW(TAG, "No SSD1306 at 0x%02X (SCL=%d SDA=%d): %s", OLED_ADDR, PIN_OLED_SCL, PIN_OLED_SDA,
                 esp_err_to_name(err));
        return err;
    }

    i2c_device_config_t dev_cfg = {
        .dev_addr_length = I2C_ADDR_BIT_LEN_7,
        .device_address = OLED_ADDR,
        .scl_speed_hz = OLED_I2C_HZ,
    };
    ESP_RETURN_ON_ERROR(i2c_master_bus_add_device(bus, &dev_cfg, &s_dev), TAG, "add device");

    static const uint8_t init[] = {
        0xAE, 0xD5, 0x80, 0xA8, OLED_H - 1, 0xD3, 0x00, 0x40, 0x8D, 0x14, 0x20, 0x00,
        0xA1, 0xC8, 0xDA, 0x02, 0x81, 0x8F, 0xD9, 0xF1, 0xDB, 0x40, 0xA4, 0xA6, 0xAF,
    };
    ESP_RETURN_ON_ERROR(send(0x00, init, sizeof(init)), TAG, "init commands");

    s_lock = xSemaphoreCreateMutex();
    s_ready = s_lock != NULL;
    display_show("GAP-AI", "starting...", NULL, NULL);
    return s_ready ? ESP_OK : ESP_ERR_NO_MEM;
}

void display_show(const char *l0, const char *l1, const char *l2, const char *l3)
{
    if (!s_ready) {
        return;
    }
    xSemaphoreTake(s_lock, portMAX_DELAY);
    memset(s_fb, 0, sizeof(s_fb));
    const char *lines[4] = {l0, l1, l2, l3};
    for (int i = 0; i < 4; i++) {
        if (lines[i]) {
            draw_line(i, lines[i]);
        }
    }
    flush();
    xSemaphoreGive(s_lock);
}

#else

esp_err_t display_init(void)
{
    return ESP_ERR_NOT_SUPPORTED;
}

void display_show(const char *l0, const char *l1, const char *l2, const char *l3)
{
}

#endif

int display_wrap(const char *text, char lines[][DISPLAY_LINE_BYTES], int max_lines)
{
    // Word-wraps UTF-8 text to DISPLAY_COLS glyphs per line (a multi-byte letter counts once).
    int n = 0;
    const char *p = text ? text : "";
    while (*p && n < max_lines) {
        while (*p == ' ') {
            p++;
        }
        if (!*p) {
            break;
        }
        const char *start = p, *cut = NULL, *q = p;
        int glyphs = 0;
        while (*q && glyphs < DISPLAY_COLS) {
            if (*q == ' ') {
                cut = q;
            }
            q++;
            while ((*q & 0xC0) == 0x80) {
                q++; // UTF-8 continuation byte
            }
            glyphs++;
        }
        const char *end = (*q && *q != ' ' && cut) ? cut : q;
        size_t len = end - start;
        if (len > DISPLAY_LINE_BYTES - 1) {
            len = DISPLAY_LINE_BYTES - 1;
        }
        memcpy(lines[n], start, len);
        lines[n][len] = '\0';
        n++;
        p = end;
    }
    return n;
}
